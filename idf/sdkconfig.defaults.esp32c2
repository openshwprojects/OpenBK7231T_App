## platforms/BL616/defconfig
```kconfig
CONFIG_NEWLIB = n
CONFIG_NEWLIB_STANDARD = n

CONFIG_VSNPRINTF_NANO = n
CONFIG_VSNPRINTF_FLOAT = y
CONFIG_VSNPRINTF_FLOAT_EX = y
CONFIG_VSNPRINTF_LONG_LONG = y

CONFIG_FREERTOS = y

CONFIG_BFLB_MTD = y
CONFIG_BFLB_OTA = y
CONFIG_PARTITION = y
CONFIG_FOTA = y
CONFIG_LWIP = y
CONFIG_RF = y
CONFIG_MBEDTLS = y
CONFIG_DHCPD = y
CONFIG_WIFI6 = y
CONFIG_MACSW_SELECT = default
CONFIG_FHOST = y
CONFIG_SHELL = n
#CONFIG_TLSF = y
CONFIG_PWRMGMT = y
CONFIG_COREDUMP = n
CONFIG_COREDUMP_V2 = n
CONFIG_LITTLEFS = n
CONFIG_BACKTRACE = n
CONFIG_IPC = n
CONFIG_MULTIMEDIA = n

#CONFIG_BLE_ENABLE = y
#CONFIG_BLUETOOTH = y
#CONFIG_BTBLECONTROLLER_LIB = ble1m10s1bredr0
#CONFIG_BLE_USE_MAC2 = n
#CONFIG_BT_STACK_CLI = y
```

## platforms/ESP-IDF/sdkconfig.defaults
```kconfig
CONFIG_ESP_PHY_INIT_DATA_IN_PARTITION=n
CONFIG_LWIP_IPV6=n
CONFIG_LWIP_IPV6_AUTOCONFIG=n
CONFIG_ESP_WIFI_ENABLE_WPA3_OWE_STA=n
CONFIG_ESP_WIFI_ENABLE_WPA3_SAE=n
CONFIG_ESP_WIFI_ENTERPRISE_SUPPORT=n
CONFIG_COMPILER_OPTIMIZATION_LEVEL_RELEASE=y
CONFIG_COMPILER_OPTIMIZATION_SIZE=y
CONFIG_NEWLIB_NANO_FORMAT=y
CONFIG_PARTITION_TABLE_SINGLE_APP=n
CONFIG_PARTITION_TABLE_TWO_OTA=y
CONFIG_BOOTLOADER_WDT_DISABLE_IN_USER_CODE=y
CONFIG_ESP_MAIN_TASK_STACK_SIZE=4096
CONFIG_VFS_SUPPORT_IO=n
CONFIG_MBEDTLS_SHA512_C=n
CONFIG_MBEDTLS_TLS_CLIENT_ONLY=y
CONFIG_HAL_LOG_LEVEL_ERROR=y

CONFIG_ESP_PROTOCOMM_SUPPORT_SECURITY_VERSION_1=n
CONFIG_ESP_PROTOCOMM_SUPPORT_SECURITY_VERSION_2=n
```

## platforms/ESP-IDF/sdkconfig.defaults.esp32
```kconfig
CONFIG_PM_ENABLE=y
CONFIG_PM_DFS_INIT_AUTO=y
CONFIG_PARTITION_TABLE_CUSTOM=y
CONFIG_ESPTOOLPY_FLASHFREQ_40M=y
CONFIG_ESPTOOLPY_FLASHFREQ="40m"
```

## platforms/ESP-IDF/sdkconfig.defaults.esp32c2
```kconfig
CONFIG_PM_ENABLE=y
CONFIG_PM_DFS_INIT_AUTO=y

CONFIG_XTAL_FREQ_26=y
CONFIG_XTAL_FREQ=26

CONFIG_RTC_CLK_SRC_INT_RC=y

CONFIG_ESP_SLEEP_POWER_DOWN_FLASH=y
CONFIG_ESP_SLEEP_CACHE_SAFE_ASSERTION=y

CONFIG_PARTITION_TABLE_CUSTOM=y
CONFIG_PARTITION_TABLE_CUSTOM_FILENAME="partitions-2mb.csv"

CONFIG_LWIP_MAX_SOCKETS=5
CONFIG_LWIP_TCPIP_RECVMBOX_SIZE=16
CONFIG_LWIP_MAX_ACTIVE_TCP=5
CONFIG_LWIP_MAX_LISTENING_TCP=5
CONFIG_LWIP_TCP_HIGH_SPEED_RETRANSMISSION=n
CONFIG_LWIP_TCP_SYNMAXRTX=12
CONFIG_LWIP_TCP_MSL=40000
CONFIG_LWIP_TCP_FIN_WAIT_TIMEOUT=16000
CONFIG_LWIP_TCP_SND_BUF_DEFAULT=4096
CONFIG_LWIP_TCP_WND_DEFAULT=2440
CONFIG_LWIP_TCP_OVERSIZE_QUARTER_MSS=y
CONFIG_LWIP_TCP_RTO_TIME=1500
CONFIG_LWIP_MAX_UDP_PCBS=8
CONFIG_LWIP_TCPIP_TASK_STACK_SIZE=2560

CONFIG_MBEDTLS_DYNAMIC_BUFFER=y
CONFIG_MBEDTLS_DYNAMIC_FREE_CONFIG_DATA=y
CONFIG_MBEDTLS_DYNAMIC_FREE_CA_CERT=y
CONFIG_MBEDTLS_SSL_VARIABLE_BUFFER_LENGTH=y
CONFIG_MBEDTLS_SSL_KEEP_PEER_CERTIFICATE=n

CONFIG_HEAP_PLACE_FUNCTION_INTO_FLASH=y

CONFIG_ESP_WIFI_STATIC_RX_BUFFER_NUM=3
CONFIG_ESP_WIFI_DYNAMIC_RX_BUFFER_NUM=6
CONFIG_ESP_WIFI_DYNAMIC_TX_BUFFER_NUM=6
CONFIG_ESP_WIFI_RX_BA_WIN=6

CONFIG_SPI_MASTER_ISR_IN_IRAM=n
CONFIG_SPI_SLAVE_ISR_IN_IRAM=n
CONFIG_SPI_FLASH_ROM_DRIVER_PATCH=n
CONFIG_SPI_FLASH_ROM_IMPL=y
```

## platforms/ESP-IDF/sdkconfig.defaults.esp32c3
```kconfig
CONFIG_PM_ENABLE=y
CONFIG_PM_DFS_INIT_AUTO=y
CONFIG_PARTITION_TABLE_CUSTOM=y
CONFIG_BT_ENABLED=y
CONFIG_BT_BLE_ENABLED=y
CONFIG_BT_BLUEDROID_ENABLED=y
CONFIG_BT_BLE_42_FEATURES_SUPPORTED=y
```
