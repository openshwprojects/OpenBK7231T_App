## libraries/ESP32_Display_Panel/src/board/supported/Kconfig.board_supported
```kconfig
choice
    prompt "Select the manufacturer"
    default ESP_PANEL_BOARD_MANUFACTURER_ALL

    config ESP_PANEL_BOARD_MANUFACTURER_ALL
        bool "All"
        help
            Espressif, Elecrow, M5Stack, Shenzhen Jingcai Intelligent, Waveshare

    config ESP_PANEL_BOARD_MANUFACTURER_ESPRESSIF
        bool "Espressif"
        help
            https://www.espressif.com/en/products/devkits

    config ESP_PANEL_BOARD_MANUFACTURER_ELECROW
        bool "Elecrow"
        help
            https://www.elecrow.com

    config ESP_PANEL_BOARD_MANUFACTURER_M5STACK
        bool "M5Stack"
        help
            https://m5stack.com/

    config ESP_PANEL_BOARD_MANUFACTURER_JINGCAI
        bool "Shenzhen Jingcai Intelligent"
        help
            https://www.displaysmodule.com/

    config ESP_PANEL_BOARD_MANUFACTURER_WAVESHARE
        bool "Waveshare"
        help
            https://www.waveshare.com/

    config ESP_PANEL_BOARD_MANUFACTURER_VIEWE
        bool "VIEWE"
        help
            https://viewedisplay.com/
endchoice

choice
    prompt "Select a target board"

    if ESP_PANEL_BOARD_MANUFACTURER_ESPRESSIF || ESP_PANEL_BOARD_MANUFACTURER_ALL
        orsource "./espressif/Kconfig.espressif"
    endif

    if ESP_PANEL_BOARD_MANUFACTURER_ELECROW || ESP_PANEL_BOARD_MANUFACTURER_ALL
        orsource "./elecrow/Kconfig.elecrow"
    endif

    if ESP_PANEL_BOARD_MANUFACTURER_M5STACK || ESP_PANEL_BOARD_MANUFACTURER_ALL
        orsource "./m5stack/Kconfig.m5stack"
    endif

    if ESP_PANEL_BOARD_MANUFACTURER_JINGCAI || ESP_PANEL_BOARD_MANUFACTURER_ALL
        orsource "./jingcai/Kconfig.jingcai"
    endif

    if ESP_PANEL_BOARD_MANUFACTURER_WAVESHARE || ESP_PANEL_BOARD_MANUFACTURER_ALL
        orsource "./waveshare/Kconfig.waveshare"
    endif

    if ESP_PANEL_BOARD_MANUFACTURER_VIEWE || ESP_PANEL_BOARD_MANUFACTURER_ALL
        orsource "./viewe/Kconfig.viewe"
    endif
endchoice
```

## libraries/ESP32_Display_Panel/src/board/supported/espressif/Kconfig.espressif
```kconfig
config BOARD_ESPRESSIF_ESP32_C3_LCDKIT
    bool "ESP32-C3-LCDkit"
    help
        https://docs.espressif.com/projects/esp-dev-kits/en/latest/esp32c3/esp32-c3-lcdkit/index.html

config BOARD_ESPRESSIF_ESP32_S3_BOX
    bool "ESP32-S3-Box"
    help
        https://github.com/espressif/esp-box/tree/master

config BOARD_ESPRESSIF_ESP32_S3_BOX_3
    bool "ESP32-S3-Box-3 & ESP32-S3-Box-3B"
    help
        https://github.com/espressif/esp-box/tree/master

config BOARD_ESPRESSIF_ESP32_S3_BOX_3_BETA
    bool "ESP32-S3-Box-3(beta)"
    help
        https://github.com/espressif/esp-box/tree/c4c954888e11250423f083df0067d99e22d59fbe

config BOARD_ESPRESSIF_ESP32_S3_BOX_LITE
    bool "ESP32-S3-Box-Lite"
    help
        https://github.com/espressif/esp-box/tree/master

config BOARD_ESPRESSIF_ESP32_S3_EYE
    bool "ESP32-S3-EYE"
    help
        https://github.com/espressif/esp-who/blob/master/docs/en/get-started/ESP32-S3-EYE_Getting_Started_Guide.md

config BOARD_ESPRESSIF_ESP32_S3_KORVO_2
    bool "ESP32-S3-Korvo-2"
    help
        https://docs.espressif.com/projects/esp-adf/en/latest/design-guide/dev-boards/user-guide-esp32-s3-korvo-2.html

config BOARD_ESPRESSIF_ESP32_S3_LCD_EV_BOARD
    bool "ESP32-S3-LCD-EV-Board(v1.1-v1.4)"
    help
        https://docs.espressif.com/projects/esp-dev-kits/en/latest/esp32s3/esp32-s3-lcd-ev-board/user_guide_v1.4.html

config BOARD_ESPRESSIF_ESP32_S3_LCD_EV_BOARD_V1_5
    bool "ESP32-S3-LCD-EV-Board(v1.5)"
    help
        https://docs.espressif.com/projects/esp-dev-kits/en/latest/esp32s3/esp32-s3-lcd-ev-board/user_guide.html

config BOARD_ESPRESSIF_ESP32_S3_LCD_EV_BOARD_2
    bool "ESP32-S3-LCD-EV-Board-2(v1.1-v1.4)"
    help
        https://docs.espressif.com/projects/esp-dev-kits/en/latest/esp32s3/esp32-s3-lcd-ev-board/user_guide_v1.4.html

config BOARD_ESPRESSIF_ESP32_S3_LCD_EV_BOARD_2_V1_5
    bool "ESP32-S3-LCD-EV-Board-2(v1.5)"
    help
        https://docs.espressif.com/projects/esp-dev-kits/en/latest/esp32s3/esp32-s3-lcd-ev-board/user_guide.html

config BOARD_ESPRESSIF_ESP32_S3_USB_OTG
    bool "ESP32-S3-USB-OTG"
    help
        https://docs.espressif.com/projects/esp-dev-kits/en/latest/esp32s3/esp32-s3-usb-otg/index.html

config BOARD_ESPRESSIF_ESP32_P4_FUNCTION_EV_BOARD
    bool "ESP32-P4-Function-EV-Board (with 7-inch 1024x600 LCD)"
    help
        https://docs.espressif.com/projects/esp-dev-kits/en/latest/esp32p4/esp32-p4-function-ev-board/index.html
```

## libraries/ESP32_Display_Panel/src/board/supported/jingcai/Kconfig.jingcai
```kconfig
config BOARD_JINGCAI_ESP32_4848S040C_I_Y_3
    bool "ESP32-4848S040C_I_Y_3"
    help
        https://www.displaysmodule.com/sale-41828962-experience-the-power-of-the-esp32-display-module-sku-esp32-4848s040c-i-y-3.html

config BOARD_JINGCAI_JC8048W550C
    bool "JC8048W550C"
    help
        https://www.displaysmodule.com/sale-43987867-capacitive-touch-advanced-tft-hmi-display-module-jc8048w550-800-480-pixel-resolution-st7262-driver-c.html
```

## libraries/ESP32_Display_Panel/src/board/supported/viewe/Kconfig.viewe
```kconfig
config BOARD_VIEWE_UEDX24320024E_WB_A
    bool "UEDX24320024E-WB-A"
    help
        https://viewedisplay.com/product/esp32-2-4-inch-240x320-rgb-ips-tft-display-touch-screen-arduino-lvgl-wifi-ble-uart-smart-module/

config BOARD_VIEWE_UEDX24320028E_WB_A
    bool "UEDX24320028E-WB-A"
    help
        https://viewedisplay.com/product/esp32-2-8-inch-240x320-mcu-ips-tft-display-touch-screen-arduino-lvgl-wifi-ble-uart-smart-module/

config BOARD_VIEWE_UEDX24320035E_WB_A
    bool "UEDX24320035E-WB-A"
    help
        https://viewedisplay.com/product/esp32-3-5-inch-240x320-mcu-ips-tft-display-touch-screen-arduino-lvgl-wifi-ble-uart-smart-module/

config BOARD_VIEWE_UEDX32480035E_WB_A
    bool "UEDX32480035E-WB-A"
    help
        https://github.com/VIEWESMART/Product-Specification-and-Schematic/blob/main/ESP32/3.5inch/320480/UEDX32480035E-WB-A%20SPEC.pdf

config BOARD_VIEWE_UEDX48270043E_WB_A
    bool "UEDX48270043E-WB-A"
    help
        https://github.com/VIEWESMART/Product-Specification-and-Schematic/blob/main/ESP32/4.3inch/Low-Resolution_480272/UEDX48270043E-WB-A%20SPEC.pdf

config BOARD_VIEWE_UEDX48480040E_WB_A
    bool "UEDX48480040E-WB-A"
    help
        https://viewedisplay.com/product/esp32-4-inch-tft-display-touch-screen-arduino-lvgl/

config BOARD_VIEWE_UEDX80480043E_WB_A
    bool "UEDX80480043E-WB-A"
    help
        https://viewedisplay.com/product/esp32-4-3-inch-800x480-rgb-ips-tft-display-touch-screen-arduino-lvgl/

config BOARD_VIEWE_UEDX80480050E_WB_A
    bool "UEDX80480050E-WB-A"
    help
        https://viewedisplay.com/product/esp32-5-inch-800x480-rgb-ips-tft-display-touch-screen-arduino-lvgl/

config BOARD_VIEWE_UEDX80480050E_WB_A_2
    bool "UEDX80480050E-WB-A-2"
    help
        https://viewedisplay.com/product/esp32-5-inch-800x480-rgb-ips-tft-display-touch-screen-arduino-lvgl/

config BOARD_VIEWE_UEDX80480070E_WB_A
    bool "UEDX80480070E-WB-A"
    help
        https://viewedisplay.com/product/esp32-7-inch-800x480-rgb-ips-tft-display-touch-screen-arduino-lvgl-uart/
```

## libraries/ESP32_Display_Panel/src/board/supported/waveshare/Kconfig.waveshare
```kconfig
config BOARD_WAVESHARE_ESP32_S3_TOUCH_LCD_1_85
    bool "ESP32_S3_TOUCH_LCD_1_85"
    help
        https://www.waveshare.com/esp32-s3-touch-lcd-1.85.htm

config BOARD_WAVESHARE_ESP32_S3_TOUCH_LCD_2_1
    bool "ESP32_S3_TOUCH_LCD_2_1"
    help
        https://www.waveshare.com/esp32-s3-touch-lcd-2.1.htm

config BOARD_WAVESHARE_ESP32_S3_TOUCH_LCD_4_3
    bool "ESP32_S3_TOUCH_LCD_4_3"
    help
        https://www.waveshare.com/esp32-s3-touch-lcd-4.3.htm

config BOARD_WAVESHARE_ESP32_S3_TOUCH_LCD_4_3_B
    bool "ESP32_S3_TOUCH_LCD_4_3_B"
    help
        https://www.waveshare.com/esp32-s3-touch-lcd-4.3B.htm

config BOARD_WAVESHARE_ESP32_S3_TOUCH_LCD_5
    bool "ESP32_S3_TOUCH_LCD_5"
    help
        https://www.waveshare.com/esp32-s3-touch-lcd-5.htm?sku=28117

config BOARD_WAVESHARE_ESP32_S3_TOUCH_LCD_5_B
    bool "ESP32_S3_TOUCH_LCD_5_B"
    help
        https://www.waveshare.com/esp32-s3-touch-lcd-5.htm?sku=28151
config BOARD_WAVESHARE_ESP32_S3_TOUCH_LCD_7
    bool "ESP32_S3_TOUCH_LCD_7"
    help
        https://www.waveshare.com/esp32-s3-touch-lcd-7.htm

config BOARD_WAVESHARE_ESP32_P4_NANO
    bool "ESP32_P4_NANO"
    help
        https://www.waveshare.com/esp32-p4-nano.htm
```

## libraries/ESP32_Display_Panel/src/drivers/Kconfig.drivers
```kconfig
menu "Drivers"
    orsource "./bus/Kconfig.bus"

    orsource "./lcd/Kconfig.lcd"

    orsource "./touch/Kconfig.touch"

    orsource "./backlight/Kconfig.backlight"

    orsource "./io_expander/Kconfig.expander"
endmenu
```

## libraries/ESP32_Display_Panel/src/drivers/touch/Kconfig.touch
```kconfig
menu "Touch"
    config ESP_PANEL_DRIVERS_TOUCH_MAX_POINTS
        int "Max point number"
        default 10
        help
            Maximum number of touch points that can be handled by the touch driver.
            This value should be set to the maximum number of touch points supported by the touch controller.

    config ESP_PANEL_DRIVERS_TOUCH_MAX_BUTTONS
        int "Max button number"
        default 5
        help
            Maximum number of buttons that can be handled by the touch driver.
            This value should be set to the maximum number of buttons supported by the touch controller.

    menu "Enable used drivers in factory"
        config ESP_PANEL_DRIVERS_TOUCH_USE_ALL
            bool "Use all"
            default n

        if !ESP_PANEL_DRIVERS_TOUCH_USE_ALL
            config ESP_PANEL_DRIVERS_TOUCH_USE_AXS15231B
                bool "Use AXS15231B"
                default n

            config ESP_PANEL_DRIVERS_TOUCH_USE_CHSC6540
                bool "Use CHSC6540"
                default n

            config ESP_PANEL_DRIVERS_TOUCH_USE_CST816S
                bool "Use CST816S"
                default n

            config ESP_PANEL_DRIVERS_TOUCH_USE_FT5x06
                bool "Use FT5x06"
                default n

            config ESP_PANEL_DRIVERS_TOUCH_USE_GT911
                bool "Use GT911"
                default n

            config ESP_PANEL_DRIVERS_TOUCH_USE_GT1151
                bool "Use GT1151"
                default n

            config ESP_PANEL_DRIVERS_TOUCH_USE_SPD2010
                bool "Use SPD2010"
                default n

            config ESP_PANEL_DRIVERS_TOUCH_USE_ST1633
                bool "Use ST1633"
                default n

            config ESP_PANEL_DRIVERS_TOUCH_USE_ST7123
                bool "Use ST7123"
                default n

            config ESP_PANEL_DRIVERS_TOUCH_USE_STMPE610
                bool "Use STMPE610"
                default n

            config ESP_PANEL_DRIVERS_TOUCH_USE_TT21100
                bool "Use TT21100"
                default n

            config ESP_PANEL_DRIVERS_TOUCH_USE_XPT2046
                bool "Use XPT2046"
                default n
        endif
    endmenu

    config ESP_PANEL_DRIVERS_TOUCH_COMPILE_UNUSED_DRIVERS
        bool "Compile unused drivers"
        default y
        help
            When disabled, code for unused drivers will be excluded to speed up compilation.
            Make sure the driver is not used when this option is disabled.

    menu "XPT2046 Configuration"
        depends on ESP_PANEL_DRIVERS_TOUCH_USE_XPT2046 || ESP_PANEL_DRIVERS_TOUCH_COMPILE_UNUSED_DRIVERS

        config ESP_PANEL_DRIVERS_TOUCH_XPT2046_Z_THRESHOLD
            int "Minimum Z pressure threshold"
            default 400
            help
                Minimum pressure threshold for touch detection.

        config ESP_PANEL_DRIVERS_TOUCH_XPT2046_INTERRUPT_MODE
            bool "Use Interrupt (PENIRQ) output"
            default n
            help
                When enabled, XPT2046 outputs low on PENIRQ when touch is detected (Full Power Mode).
                Consumes more power but provides interrupt capability.

        config ESP_PANEL_DRIVERS_TOUCH_XPT2046_VREF_ON_MODE
            bool "Keep internal Vref enabled"
            default n
            help
                When enabled, internal Vref remains on between conversions. Slightly higher power consumption,
                but requires fewer transactions for battery voltage, aux voltage and temperature readings.

        config ESP_PANEL_DRIVERS_TOUCH_XPT2046_CONVERT_ADC_TO_COORDS
            bool "Convert touch coordinates to screen coordinates"
            default y
            help
                When enabled, raw ADC values (0-4096) are converted to screen coordinates.
                When disabled, process_coordinates must be called manually to convert values.

        config ESP_PANEL_DRIVERS_TOUCH_XPT2046_ENABLE_LOCKING
            bool "Use data structure locking"
            default n
            help
                When enabled, driver locks touch position data structures during reads.
                Warning: May cause unexpected crashes.
    endmenu
endmenu
```

## libraries/ESP32_Display_Panel/test_apps/board/espressif/sdkconfig.defaults
```kconfig
CONFIG_ESP_TASK_WDT_EN=n
CONFIG_FREERTOS_HZ=1000
CONFIG_COMPILER_CXX_EXCEPTIONS=y

CONFIG_ESP_PANEL_BOARD_DEFAULT_USE_SUPPORTED=y
CONFIG_ESP_PANEL_BOARD_MANUFACTURER_ALL=y
```

## libraries/ESP32_Display_Panel/test_apps/gui/lvgl_v8_port/sdkconfig.defaults
```kconfig
CONFIG_ESP_TASK_WDT_EN=n
CONFIG_FREERTOS_HZ=1000
CONFIG_COMPILER_CXX_EXCEPTIONS=y

CONFIG_ESPTOOLPY_FLASHSIZE_4MB=y
CONFIG_PARTITION_TABLE_CUSTOM=y

CONFIG_ESP_PANEL_BOARD_DEFAULT_USE_SUPPORTED=y
CONFIG_ESP_PANEL_BOARD_MANUFACTURER_ALL=y

CONFIG_LV_USE_LOG=y
CONFIG_LV_LOG_PRINTF=y
# Use these two config will lead memory leak due to `lv_deinit()` will not work
# CONFIG_LV_MEM_CUSTOM=y
# CONFIG_LV_MEMCPY_MEMSET_STD=y
CONFIG_LV_MEM_SIZE_KILOBYTES=64
CONFIG_LV_USE_PERF_MONITOR=y
CONFIG_LV_FONT_MONTSERRAT_12=y
CONFIG_LV_FONT_MONTSERRAT_16=y
CONFIG_LV_FONT_MONTSERRAT_18=y
CONFIG_LV_FONT_MONTSERRAT_20=y
CONFIG_LV_FONT_MONTSERRAT_22=y
CONFIG_LV_FONT_MONTSERRAT_24=y
CONFIG_LV_FONT_MONTSERRAT_26=y
CONFIG_LV_FONT_MONTSERRAT_28=y
CONFIG_LV_FONT_MONTSERRAT_30=y
CONFIG_LV_FONT_MONTSERRAT_32=y
CONFIG_LV_FONT_MONTSERRAT_34=y
CONFIG_LV_USE_DEMO_WIDGETS=y
CONFIG_LV_USE_DEMO_KEYPAD_AND_ENCODER=y
CONFIG_LV_USE_DEMO_BENCHMARK=y
CONFIG_LV_USE_DEMO_STRESS=y
CONFIG_LV_USE_DEMO_MUSIC=y
CONFIG_LV_DEMO_MUSIC_AUTO_PLAY=y
```

## libraries/esp-lib-utils/test_apps/sdkconfig.defaults
```kconfig
CONFIG_ESP_TASK_WDT_EN=n
CONFIG_FREERTOS_HZ=1000
CONFIG_COMPILER_CXX_EXCEPTIONS=y
```

## platforms/BL602_ALT/defconfig
```kconfig
CONFIG_NEWLIB = y
CONFIG_NEWLIB_STANDARD = n

CONFIG_VSNPRINTF_NANO = n
CONFIG_VSNPRINTF_FLOAT = y
CONFIG_VSNPRINTF_FLOAT_EX = y
CONFIG_VSNPRINTF_LONG_LONG = y

CONFIG_FREERTOS = y

CONFIG_BFLB_MTD = y
CONFIG_BFLB_OTA = y
CONFIG_PARTITION = y
CONFIG_FOTA = y
CONFIG_LWIP = y
CONFIG_RF = y
CONFIG_MBEDTLS = y
CONFIG_DHCPD = y
CONFIG_WIFI4 = y
#CONFIG_MACSW_SELECT = default
#CONFIG_FHOST = y
CONFIG_SHELL = n
CONFIG_TLSF = y
#CONFIG_PWRMGMT = y
CONFIG_COREDUMP = n
CONFIG_COREDUMP_V2 = n
CONFIG_LITTLEFS = n
CONFIG_BACKTRACE = n
CONFIG_IPC = n
CONFIG_MULTIMEDIA = n
#CONFIG_ROMAPI = n
CONFIG_PING = n
CONFIG_BFLB_LOG = n
CONFIG_LOG_DISABLE = y
CONFIG_ASSERT_DISABLE = y
```
