## idf/sdkconfig.defaults.esp32c2
```kconfig
CONFIG_PM_ENABLE=y
CONFIG_PM_DFS_INIT_AUTO=y

CONFIG_XTAL_FREQ_26=y
CONFIG_XTAL_FREQ=26

CONFIG_ESP_SLEEP_POWER_DOWN_FLASH=y
CONFIG_ESP_SLEEP_CACHE_SAFE_ASSERTION=y

CONFIG_RTC_CLK_SRC_EXT_OSC=y

CONFIG_PARTITION_TABLE_CUSTOM=y
CONFIG_PARTITION_TABLE_CUSTOM_FILENAME="partitions-2mb.csv"

CONFIG_LWIP_MAX_SOCKETS=6
CONFIG_MBEDTLS_DYNAMIC_BUFFER=y
CONFIG_MBEDTLS_DYNAMIC_FREE_CONFIG_DATA=y
CONFIG_MBEDTLS_DYNAMIC_FREE_CA_CERT=y
CONFIG_HEAP_PLACE_FUNCTION_INTO_FLASH=y

CONFIG_ESP_WIFI_STATIC_RX_BUFFER_NUM=3
CONFIG_ESP_WIFI_DYNAMIC_RX_BUFFER_NUM=6
CONFIG_ESP_WIFI_DYNAMIC_TX_BUFFER_NUM=6
CONFIG_ESP_WIFI_RX_BA_WIN=6
CONFIG_LWIP_TCP_SND_BUF_DEFAULT=6
CONFIG_LWIP_TCP_WND_DEFAULT=6
CONFIG_LWIP_IRAM_OPTIMIZATION=0
```

## idf/sdkconfig.defaults.esp32s3
```kconfig
CONFIG_PM_ENABLE=y
CONFIG_PM_DFS_INIT_AUTO=y
CONFIG_PARTITION_TABLE_CUSTOM=y
CONFIG_PARTITION_TABLE_CUSTOM_FILENAME="partitions-4mb.csv"
CONFIG_ESPTOOLPY_FLASHSIZE_4MB=y
CONFIG_ESPTOOLPY_FLASHSIZE="4MB"
```

## libraries/ESP32_Display_Panel/Kconfig
```kconfig
menu "ESP Display Panel Configurations"
    config ESP_PANEL_DRIVERS_FILE_SKIP
        bool "Enable to skip `esp_panel_drivers_conf.h`"
        default y
        help
            If want to use `esp_panel_drivers_conf.h` to configure the panel, uncheck this option. Otherwise, the configurations in sdkconfig will be used.

    config ESP_PANEL_BOARD_FILE_SKIP
        bool "Enable to skip `esp_panel_board_*.h`"
        default y
        help
            If want to use `esp_panel_board_*.h` to configure the panel, uncheck this option. Otherwise, the configurations in sdkconfig will be used.

    if ESP_PANEL_DRIVERS_FILE_SKIP
        orsource "./src/drivers/Kconfig.drivers"
    endif

    if ESP_PANEL_BOARD_FILE_SKIP
        orsource "./src/board/Kconfig.board"
    endif

endmenu
```

## libraries/ESP32_Display_Panel/src/board/Kconfig.board
```kconfig
menu "Board"
    choice
        prompt "Select the default board type"
        default ESP_PANEL_BOARD_DEFAULT_USE_NONE

        config ESP_PANEL_BOARD_DEFAULT_USE_NONE
            bool "None"
            help
                Enable this option if not using a board.

        config ESP_PANEL_BOARD_DEFAULT_USE_SUPPORTED
            bool "Supported board"
            help
                Enable this option if using a supported board.

        config ESP_PANEL_BOARD_DEFAULT_USE_CUSTOM
            bool "Custom board"
            help
                Select this option if using a custom board.
    endchoice

    if ESP_PANEL_BOARD_DEFAULT_USE_SUPPORTED
        orsource "./supported/Kconfig.board_supported"
    endif

    if ESP_PANEL_BOARD_DEFAULT_USE_CUSTOM
        orsource "./custom/Kconfig.board_custom"
    endif
endmenu
```

## libraries/ESP32_Display_Panel/src/board/custom/Kconfig.board_custom
```kconfig
config ESP_PANEL_BOARD_NAME
    string "Board name (Manufacturer:Model)"
    default "Custom:Custom"
    help
        Board name. (format: "Manufacturer:Model")

config ESP_PANEL_BOARD_WIDTH
    int "Panel width (horizontal, in pixels)"
    default 320
    range 1 10000

config ESP_PANEL_BOARD_HEIGHT
    int "Panel height (vertical, in pixels)"
    default 240
    range 1 10000

orsource "./Kconfig.board_custom.lcd"

orsource "./Kconfig.board_custom.touch"

orsource "./Kconfig.board_custom.backlight"

orsource "./Kconfig.board_custom.expander"
```
