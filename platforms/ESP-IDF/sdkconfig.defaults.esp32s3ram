## src/libraries/ESP32_Display_Panel/src/drivers/backlight/Kconfig.backlight
```kconfig
menu "Backlight"
    menu "Enable used drivers in factory"
        config ESP_PANEL_DRIVERS_BACKLIGHT_USE_ALL
            bool "Use all"
            default n

        if !ESP_PANEL_DRIVERS_BACKLIGHT_USE_ALL
            config ESP_PANEL_DRIVERS_BACKLIGHT_USE_SWITCH_GPIO
                bool "Use switch (GPIO)"
                default n

            config ESP_PANEL_DRIVERS_BACKLIGHT_USE_SWITCH_EXPANDER
                bool "Use switch (Expander)"
                default n

            config ESP_PANEL_DRIVERS_BACKLIGHT_USE_PWM_LEDC
                bool "Use PWM (LEDC)"
                default n

            config ESP_PANEL_DRIVERS_BACKLIGHT_USE_CUSTOM
                bool "Use custom function"
                default n
        endif
    endmenu

    config ESP_PANEL_DRIVERS_BACKLIGHT_COMPILE_UNUSED_DRIVERS
        bool "Compile unused drivers"
        default y
        help
            When disabled, code for unused drivers will be excluded to speed up compilation.
            Make sure the driver is not used when this option is disabled.
endmenu
```

## src/libraries/ESP32_Display_Panel/src/drivers/bus/Kconfig.bus
```kconfig
menu "Bus"
    menu "Enable used drivers in factory"
        config ESP_PANEL_DRIVERS_BUS_USE_ALL
            bool "Use all"
            default n

        if !ESP_PANEL_DRIVERS_BUS_USE_ALL
            config ESP_PANEL_DRIVERS_BUS_USE_SPI
                bool "Use SPI"
                default n

            config ESP_PANEL_DRIVERS_BUS_USE_QSPI
                bool "Use QSPI"
                default n

            config ESP_PANEL_DRIVERS_BUS_USE_RGB
                bool "Use RGB"
                default n

            config ESP_PANEL_DRIVERS_BUS_USE_I2C
                bool "Use I2C"
                default n

            config ESP_PANEL_DRIVERS_BUS_USE_MIPI_DSI
                bool "Use MIPI DSI"
                default n
        endif
    endmenu

    config ESP_PANEL_DRIVERS_BUS_COMPILE_UNUSED_DRIVERS
        bool "Compile unused drivers"
        default y
        help
            When disabled, code for unused drivers will be excluded to speed up compilation.
            Make sure the driver is not used when this option is disabled.
endmenu
```

## src/libraries/ESP32_Display_Panel/src/drivers/io_expander/Kconfig.expander
```kconfig
menu "IO Expander"
    menu "Enable used drivers in factory"
        config ESP_PANEL_DRIVERS_EXPANDER_USE_ALL
            bool "Use all"
            default n

        if !ESP_PANEL_DRIVERS_EXPANDER_USE_ALL
            config ESP_PANEL_DRIVERS_EXPANDER_USE_CH422G
                bool "Use CH422G"
                default n

            config ESP_PANEL_DRIVERS_EXPANDER_USE_HT8574
                bool "Use HT8574"
                default n

            config ESP_PANEL_DRIVERS_EXPANDER_USE_TCA95XX_8BIT
                bool "Use TCA95XX (8-bit)"
                default n

            config ESP_PANEL_DRIVERS_EXPANDER_USE_TCA95XX_16BIT
                bool "Use TCA95XX (16-bit)"
                default n
        endif
    endmenu
endmenu
```

## src/libraries/ESP32_Display_Panel/src/drivers/lcd/Kconfig.lcd
```kconfig
menu "LCD"
    menu "Enable used drivers in factory"
        config ESP_PANEL_DRIVERS_LCD_USE_ALL
            bool "Use all"
            default n

        if !ESP_PANEL_DRIVERS_LCD_USE_ALL
            config ESP_PANEL_DRIVERS_LCD_USE_AXS15231B
                bool "Use AXS15231B"
                default n

            config ESP_PANEL_DRIVERS_LCD_USE_EK9716B
                bool "Use EK9716B"
                default n

            config ESP_PANEL_DRIVERS_LCD_USE_EK79007
                bool "Use EK79007"
                default n

            config ESP_PANEL_DRIVERS_LCD_USE_GC9A01
                bool "Use GC9A01"
                default n

            config ESP_PANEL_DRIVERS_LCD_USE_GC9B71
                bool "Use GC9B71"
                default n

            config ESP_PANEL_DRIVERS_LCD_USE_GC9503
                bool "Use GC9503"
                default n

            config ESP_PANEL_DRIVERS_LCD_USE_HX8399
                bool "Use HX8399"
                default n

            config ESP_PANEL_DRIVERS_LCD_USE_ILI9341
                bool "Use ILI9341"
                default n

            config ESP_PANEL_DRIVERS_LCD_USE_ILI9881C
                bool "Use ILI9881C"
                default n

            config ESP_PANEL_DRIVERS_LCD_USE_JD9165
                bool "Use JD9165"
                default n

            config ESP_PANEL_DRIVERS_LCD_USE_JD9365
                bool "Use JD9365"
                default n

            config ESP_PANEL_DRIVERS_LCD_USE_NV3022B
                bool "Use NV3022B"
                default n

            config ESP_PANEL_DRIVERS_LCD_USE_SH8601
                bool "Use SH8601"
                default n

            config ESP_PANEL_DRIVERS_LCD_USE_SPD2010
                bool "Use SPD2010"
                default n

            config ESP_PANEL_DRIVERS_LCD_USE_ST7262
                bool "Use ST7262"
                default n

            config ESP_PANEL_DRIVERS_LCD_USE_ST7701
                bool "Use ST7701"
                default n

            config ESP_PANEL_DRIVERS_LCD_USE_ST7703
                bool "Use ST7703"
                default n

            config ESP_PANEL_DRIVERS_LCD_USE_ST7789
                bool "Use ST7789"
                default n

            config ESP_PANEL_DRIVERS_LCD_USE_ST7796
                bool "Use ST7796"
                default n

            config ESP_PANEL_DRIVERS_LCD_USE_ST77903
                bool "Use ST77903"
                default n

            config ESP_PANEL_DRIVERS_LCD_USE_ST77916
                bool "Use ST77916"
                default n

            config ESP_PANEL_DRIVERS_LCD_USE_ST77922
                bool "Use ST77922"
                default n
        endif
    endmenu

    config ESP_PANEL_DRIVERS_LCD_COMPILE_UNUSED_DRIVERS
        bool "Compile unused drivers"
        default y
        help
            When disabled, code for unused drivers will be excluded to speed up compilation.
            Make sure the driver is not used when this option is disabled.
endmenu
```

## src/libraries/ESP32_Display_Panel/test_apps/board/common/sdkconfig.defaults
```kconfig
CONFIG_ESP_TASK_WDT_EN=n
CONFIG_FREERTOS_HZ=1000
CONFIG_COMPILER_CXX_EXCEPTIONS=y

CONFIG_ESP_PANEL_DRIVERS_BUS_USE_ALL=y
CONFIG_ESP_PANEL_DRIVERS_LCD_USE_ALL=y
CONFIG_ESP_PANEL_DRIVERS_TOUCH_USE_ALL=y
CONFIG_ESP_PANEL_DRIVERS_EXPANDER_USE_ALL=y
CONFIG_ESP_PANEL_DRIVERS_BACKLIGHT_USE_ALL=y
```

## src/libraries/ESP32_Display_Panel/test_apps/board/m5stack/sdkconfig.defaults.esp32s3
```kconfig
CONFIG_COMPILER_OPTIMIZATION_PERF=y

CONFIG_SPIRAM=y
CONFIG_SPIRAM_SPEED_80M=y
# Enable the XIP-PSRAM feature, so the ext-mem cache won't be disabled when SPI1 is operating the main flash
# For v5.2 and below
CONFIG_SPIRAM_FETCH_INSTRUCTIONS=y
CONFIG_SPIRAM_RODATA=y
# For v5.3 and above
CONFIG_SPIRAM_XIP_FROM_PSRAM=y

# Used in conjunction with "RGB Bounce Buffer"
CONFIG_ESP32S3_DATA_CACHE_LINE_64B=y
```

## src/libraries/ESP32_Display_Panel/test_apps/drivers/lcd/spi/sdkconfig.defaults
```kconfig
CONFIG_ESP_TASK_WDT=
CONFIG_FREERTOS_HZ=1000
CONFIG_COMPILER_CXX_EXCEPTIONS=y
CONFIG_ESP_CONSOLE_USB_SERIAL_JTAG=y
```

## src/libraries/ESP32_Display_Panel/test_apps/gui/lvgl_v8_port/main/Kconfig.projbuild
```kconfig
menu "Test Configurations"
    choice LVGL_PORT_AVOID_TEARING_MODE_CHOICE
        prompt "Avoid Tearing Mode"
        default LVGL_PORT_AVOID_TEARING_MODE_NONE

        config LVGL_PORT_AVOID_TEARING_MODE_NONE
            bool "None"

        config LVGL_PORT_AVOID_TEARING_MODE_1
            bool "Mode1: LCD double-buffer & LVGL full-refresh"
            depends on SOC_LCD_RGB_SUPPORTED || SOC_MIPI_DSI_SUPPORTED

        config LVGL_PORT_AVOID_TEARING_MODE_2
            bool "Mode2: LCD triple-buffer & LVGL full-refresh"
            depends on SOC_LCD_RGB_SUPPORTED || SOC_MIPI_DSI_SUPPORTED

        config LVGL_PORT_AVOID_TEARING_MODE_3
            bool "Mode3: LCD double-buffer & LVGL direct-mode (recommended)"
            depends on SOC_LCD_RGB_SUPPORTED || SOC_MIPI_DSI_SUPPORTED
    endchoice

    config LVGL_PORT_AVOID_TEARING_MODE
        int
        default 3 if LVGL_PORT_AVOID_TEARING_MODE_3
        default 2 if LVGL_PORT_AVOID_TEARING_MODE_2
        default 1 if LVGL_PORT_AVOID_TEARING_MODE_1
        default 0 if LVGL_PORT_AVOID_TEARING_MODE_NONE

    choice LVGL_PORT_ROTATION_DEGREE_CHOICE
        prompt "Rotation Degree"
        default LVGL_PORT_ROTATION_DEGREE_0

        config LVGL_PORT_ROTATION_DEGREE_0
            bool "0 degree"
            depends on LVGL_PORT_AVOID_TEARING_MODE != 0

        config LVGL_PORT_ROTATION_DEGREE_90
            bool "90 degree"
            depends on LVGL_PORT_AVOID_TEARING_MODE != 0

        config LVGL_PORT_ROTATION_DEGREE_180
            bool "180 degree"
            depends on LVGL_PORT_AVOID_TEARING_MODE != 0

        config LVGL_PORT_ROTATION_DEGREE_270
            bool "270 degree"
            depends on LVGL_PORT_AVOID_TEARING_MODE != 0
    endchoice

    config LVGL_PORT_ROTATION_DEGREE
        int
        default 0 if LVGL_PORT_ROTATION_DEGREE_0
        default 90 if LVGL_PORT_ROTATION_DEGREE_90
        default 180 if LVGL_PORT_ROTATION_DEGREE_180
        default 270 if LVGL_PORT_ROTATION_DEGREE_270
endmenu
```

## src/libraries/esp-lib-utils/Kconfig
```kconfig
menu "ESP Library Utils Configurations"
    config ESP_UTILS_CONF_FILE_SKIP
        bool "Unckeck this to use custom `esp_utils_conf.h`"
        default y

    menu "Check functions"
        depends on ESP_UTILS_CONF_FILE_SKIP
        choice ESP_UTILS_CONF_CHECK_HANDLE_METHOD
            prompt "Select handle method when check failed"
            default ESP_UTILS_CHECK_HANDLE_WITH_ERROR_LOG

            config ESP_UTILS_CHECK_HANDLE_WITH_NONE
                bool "Do nothing"

            config ESP_UTILS_CHECK_HANDLE_WITH_ERROR_LOG
                bool "Print error message"

            config ESP_UTILS_CHECK_HANDLE_WITH_ASSERT
                bool "Assert"
        endchoice

        config ESP_UTILS_CONF_CHECK_HANDLE_METHOD
            int
            default 0 if ESP_UTILS_CHECK_HANDLE_WITH_NONE
            default 1 if ESP_UTILS_CHECK_HANDLE_WITH_ERROR_LOG
            default 2 if ESP_UTILS_CHECK_HANDLE_WITH_ASSERT
    endmenu

    menu "Log functions"
        depends on ESP_UTILS_CONF_FILE_SKIP

        choice ESP_UTILS_CONF_LOG_LEVEL
            prompt "Select global log level"
            default ESP_UTILS_CONF_LOG_LEVEL_INFO

            config ESP_UTILS_CONF_LOG_LEVEL_DEBUG
                bool "Debug"
                help
                    Extra information which is not necessary for normal use (values, pointers, sizes, etc)

            config ESP_UTILS_CONF_LOG_LEVEL_INFO
                bool "Info"
                help
                    Information messages which describe the normal flow of events

            config ESP_UTILS_CONF_LOG_LEVEL_WARNING
                bool "Warning"
                help
                    Error conditions from which recovery measures have been taken

            config ESP_UTILS_CONF_LOG_LEVEL_ERROR
                bool "Error"
                help
                    Critical errors, software module cannot recover on its own

            config ESP_UTILS_CONF_LOG_LEVEL_NONE
                bool "None"
                help
                    No log output
        endchoice

        config ESP_UTILS_CONF_LOG_LEVEL
            int
            default 0 if ESP_UTILS_CONF_LOG_LEVEL_DEBUG
            default 1 if ESP_UTILS_CONF_LOG_LEVEL_INFO
            default 2 if ESP_UTILS_CONF_LOG_LEVEL_WARNING
            default 3 if ESP_UTILS_CONF_LOG_LEVEL_ERROR
            default 4 if ESP_UTILS_CONF_LOG_LEVEL_NONE

        config ESP_UTILS_CONF_ENABLE_LOG_TRACE
            bool "Enable trace function"
            depends on ESP_UTILS_CONF_LOG_LEVEL_DEBUG
            default n
            help
                If enabled, the driver will print trace log messages when enter/exit functions, useful for debugging
    endmenu

    menu "Memory functions"
        depends on ESP_UTILS_CONF_FILE_SKIP
        config ESP_UTILS_CONF_MEM_GEN_ALLOC_DEFAULT_ENABLE
            bool "Default enable general memory allocation"
            default y
            help
                If enabled, the driver will use general memory allocation by default, otherwise, the driver will use
                `malloc` and `free` by default

        choice ESP_UTILS_CONF_MEM_GEN_ALLOC_TYPE_CHOICE
            prompt "Select general allocation type"
            default ESP_UTILS_CONF_MEM_GEN_ALLOC_TYPE_STDLIB

            config ESP_UTILS_CONF_MEM_GEN_ALLOC_TYPE_STDLIB
                bool "Standard library (malloc, free)"

            config ESP_UTILS_CONF_MEM_GEN_ALLOC_TYPE_ESP
                bool "ESP (heap_caps_malloc, free)"

            config ESP_UTILS_CONF_MEM_GEN_ALLOC_TYPE_MICROPYTHON
                bool "MicroPython (mp_malloc, mp_free)"

            config ESP_UTILS_CONF_MEM_GEN_ALLOC_TYPE_CUSTOM
                bool "Custom (`ESP_UTILS_CONF_MEM_GEN_ALLOC_CUSTOM_MALLOC` and `ESP_UTILS_CONF_MEM_GEN_ALLOC_CUSTOM_FREE`)"
        endchoice

        config ESP_UTILS_CONF_MEM_GEN_ALLOC_TYPE
            int
            default 0 if ESP_UTILS_CONF_MEM_GEN_ALLOC_TYPE_STDLIB
            default 1 if ESP_UTILS_CONF_MEM_GEN_ALLOC_TYPE_ESP
            default 2 if ESP_UTILS_CONF_MEM_GEN_ALLOC_TYPE_MICROPYTHON
            default 3 if ESP_UTILS_CONF_MEM_GEN_ALLOC_TYPE_CUSTOM

        config ESP_UTILS_CONF_MEM_GEN_ALLOC_ESP_ALIGN
            int "General esp memory alignment (bytes)"
            depends on ESP_UTILS_CONF_MEM_GEN_ALLOC_TYPE_ESP
            default 1
            range 1 1024

        config ESP_UTILS_CONF_MEM_GEN_ALLOC_CUSTOM_INCLUDE
            string "General custom memory header file"
            depends on ESP_UTILS_CONF_MEM_GEN_ALLOC_TYPE_CUSTOM
            default "stdlib.h"
    endmenu
endmenu
```
