## platforms/ESP-IDF/sdkconfig.defaults.esp32s3ram
```kconfig
CONFIG_PM_ENABLE=y
CONFIG_PM_DFS_INIT_AUTO=y
CONFIG_PARTITION_TABLE_CUSTOM=y
CONFIG_SPIRAM=y
CONFIG_SPIRAM_MODE_OCT=y
CONFIG_SPIRAM_SPEED_80M=y
CONFIG_SPIRAM_FETCH_INSTRUCTIONS=y
CONFIG_SPIRAM_RODATA=y
```

## platforms/ESP8266/sdkconfig.defaults
```kconfig
CONFIG_ESP_PHY_INIT_DATA_IN_PARTITION=n
CONFIG_LWIP_IPV6=n
CONFIG_LWIP_IPV6_AUTOCONFIG=n
CONFIG_ESP_WIFI_ENABLE_WPA3_OWE_STA=n
CONFIG_ESP_WIFI_ENTERPRISE_SUPPORT=n
CONFIG_COMPILER_OPTIMIZATION_LEVEL_RELEASE=y
CONFIG_COMPILER_OPTIMIZATION_SIZE=y
CONFIG_BOOTLOADER_WDT_DISABLE_IN_USER_CODE=y
CONFIG_ESP_MAIN_TASK_STACK_SIZE=3072
CONFIG_ESP_TIMER_TASK_STACK_SIZE=2048
CONFIG_ESP8266_WIFI_ENABLE_WPA3_SAE=n
#CONFIG_WIFI_PPT_TASKSTACK_SIZE=4096
CONFIG_VFS_SUPPORT_IO=n
CONFIG_MBEDTLS_SHA512_C=n
CONFIG_MBEDTLS_TLS_CLIENT_ONLY=y
CONFIG_HAL_LOG_LEVEL_ERROR=y

CONFIG_PARTITION_TABLE_CUSTOM=y
CONFIG_PARTITION_TABLE_CUSTOM_FILENAME="partitions.csv"
CONFIG_LWIP_TCP_MSL=1000
CONFIG_ESPTOOLPY_FLASHSIZE_16MB=y
CONFIG_ESPTOOLPY_FLASHSIZE="16MB"
CONFIG_ESP_CONSOLE_UART_BAUDRATE=115200
CONFIG_LWIP_ESP_LWIP_ASSERT=n
CONFIG_MBEDTLS_SSL_PROTO_TLS1=n
CONFIG_MBEDTLS_SSL_PROTO_TLS1_1=n

CONFIG_LWIP_MAX_SOCKETS=8
CONFIG_LWIP_MAX_ACTIVE_TCP=6
CONFIG_LWIP_MAX_LISTENING_TCP=3
CONFIG_LWIP_MAX_UDP_PCBS=1
CONFIG_LWIP_MAX_RAW_PCBS=1
CONFIG_LWIP_IP4_FRAG=n
CONFIG_LWIP_IP6_FRAG=n

CONFIG_SUPPORT_TERMIOS=n
CONFIG_ESPTOOLPY_FLASHMODE_DOUT=y
CONFIG_ESPTOOLPY_FLASHMODE="dout"
CONFIG_NEWLIB_NANO_FORMAT=y

CONFIG_ESP_SYSTEM_EVENT_TASK_STACK_SIZE=1024
CONFIG_ESP_SYSTEM_EVENT_QUEUE_SIZE=8
CONFIG_ESP_ERR_TO_NAME_LOOKUP=n
#CONFIG_ESP8266_CORE_GLOBAL_DATA_LINK_IRAM=n

CONFIG_LWIP_DHCPS_MAX_STATION_NUM=2
CONFIG_ESP8266_WIFI_RX_BUFFER_NUM=14
CONFIG_ESP8266_WIFI_LEFT_CONTINUOUS_RX_BUFFER_NUM=8
CONFIG_ESP8266_WIFI_RX_PKT_NUM=4
CONFIG_ESP8266_WIFI_TX_PKT_NUM=4
CONFIG_ESP_HTTP_CLIENT_ENABLE_HTTPS=n
CONFIG_FREERTOS_TIMER_STACKSIZE=1024
CONFIG_TASK_SWITCH_FASTER=n
CONFIG_LOG_COLORS=n
CONFIG_MBEDTLS_DYNAMIC_BUFFER=y
```

## src/libraries/ESP32_Display_Panel/examples/esp_idf/lvgl_v8_port/sdkconfig.defaults.esp32p4
```kconfig
CONFIG_COMPILER_OPTIMIZATION_PERF=y

CONFIG_SPIRAM=y
CONFIG_SPIRAM_MODE_HEX=y
CONFIG_SPIRAM_SPEED_200M=y
CONFIG_SPIRAM_XIP_FROM_PSRAM=y

CONFIG_IDF_EXPERIMENTAL_FEATURES=y
```

## src/libraries/ESP32_Display_Panel/src/board/custom/Kconfig.board_custom.backlight
```kconfig
menuconfig ESP_PANEL_BOARD_USE_BACKLIGHT
    bool "Backlight settings"
    default n
    help
        Enable this option if you are using a backlight.

if ESP_PANEL_BOARD_USE_BACKLIGHT
    choice
        prompt "Backlight type"
        default ESP_PANEL_BOARD_BACKLIGHT_TYPE_PWM_LEDC

        config ESP_PANEL_BOARD_BACKLIGHT_TYPE_SWITCH_GPIO
            bool "Switch (GPIO)"
            help
                Use switch(GPIO) to control the backlight.

        config ESP_PANEL_BOARD_BACKLIGHT_TYPE_SWITCH_EXPANDER
            bool "Switch (Expander)"
            help
                Use switch(Expander) to control the backlight.

        config ESP_PANEL_BOARD_BACKLIGHT_TYPE_PWM_LEDC
            bool "PWM (LEDC)"
            help
                Use PWM(LEDC) to control the backlight.

        config ESP_PANEL_BOARD_BACKLIGHT_TYPE_CUSTOM
            bool "Custom"
            help
                Use custom function to control the backlight.
    endchoice

    config ESP_PANEL_BOARD_BACKLIGHT_TYPE
        int
        default 0 if ESP_PANEL_BOARD_BACKLIGHT_TYPE_SWITCH_GPIO
        default 1 if ESP_PANEL_BOARD_BACKLIGHT_TYPE_SWITCH_EXPANDER
        default 2 if ESP_PANEL_BOARD_BACKLIGHT_TYPE_PWM_LEDC
        default 3 if ESP_PANEL_BOARD_BACKLIGHT_TYPE_CUSTOM
        help
            Backlight type.

    menu "Control pin"
        depends on ESP_PANEL_BOARD_BACKLIGHT_TYPE_SWITCH_GPIO || ESP_PANEL_BOARD_BACKLIGHT_TYPE_SWITCH_EXPANDER || ESP_PANEL_BOARD_BACKLIGHT_TYPE_PWM_LEDC

        config ESP_PANEL_BOARD_BACKLIGHT_IO
            int "Pin"
            default 0
            range 0 1000
            help
                GPIO number for backlight control.

        config ESP_PANEL_BOARD_BACKLIGHT_ON_LEVEL
            int "Active level"
            default 1
            range 0 1
            help
                Active level for backlight control.
    endmenu

    menu "PWM parameters"
        depends on ESP_PANEL_BOARD_BACKLIGHT_TYPE_PWM_LEDC

        config ESP_PANEL_BOARD_BACKLIGHT_PWM_FREQ_HZ
            int "Frequency"
            default 5000
            help
                Frequency for PWM control.

        config ESP_PANEL_BOARD_BACKLIGHT_PWM_DUTY_RESOLUTION
            int "Duty resolution"
            default 10
            range 1 20
            help
                Duty resolution for PWM control.
    endmenu

    config ESP_PANEL_BOARD_BACKLIGHT_IDLE_OFF
        bool "Idle off"
        default n
        help
            Set to 1 if you want to turn off the backlight after initializing the panel; otherwise, set it to turn on.
endif
```

## src/libraries/ESP32_Display_Panel/src/board/custom/Kconfig.board_custom.expander
```kconfig
menuconfig ESP_PANEL_BOARD_USE_EXPANDER
    bool "IO expander settings"
    default n
    help
        Enable this option if you are using an IO expander.

if ESP_PANEL_BOARD_USE_EXPANDER
    choice
        prompt "Chip"
        default ESP_PANEL_BOARD_EXPANDER_CHIP_TCA95XX_8BIT
        help
            Select the IO expander chip model.

        config ESP_PANEL_BOARD_EXPANDER_CHIP_CH422G
            bool "CH422G"

        config ESP_PANEL_BOARD_EXPANDER_CHIP_HT8574
            bool "HT8574"

        config ESP_PANEL_BOARD_EXPANDER_CHIP_TCA95XX_8BIT
            bool "TCA95XX_8BIT"

        config ESP_PANEL_BOARD_EXPANDER_CHIP_TCA95XX_16BIT
            bool "TCA95XX_16BIT"
    endchoice

    config ESP_PANEL_BOARD_EXPANDER_SKIP_INIT_HOST
        bool "Skip bus host initialization"
        default n
        help
            If enabled, the bus will skip initializing the corresponding host.
            Users need to initialize the host in advance.
            For drivers created by this library, even if they use the same host,
            the host will be initialized only once. So it is not necessary to enable this.
            For other devices, please enable this to ensure the host is initialized only once.

    menu "I2C bus settings"
        config ESP_PANEL_BOARD_EXPANDER_I2C_HOST_ID
            int "I2C host ID"
            default 0
            range 0 1
            help
                I2C host ID, typically set to 0.

        config ESP_PANEL_BOARD_EXPANDER_I2C_ADDRESS
            int "I2C address (7-bit)"
            default 0
            range 0 127
            help
                The actual I2C address. Even for the same model of IC,
                the I2C address may be different, and confirmation based on
                the actual hardware connection is required.

        if !ESP_PANEL_BOARD_EXPANDER_SKIP_INIT_HOST
            config ESP_PANEL_BOARD_EXPANDER_I2C_CLK_HZ
                int "Clock frequency (Hz)"
                default 400000
                range 1 400000
                help
                    I2C clock frequency, typically set to 400KHz.

            menu "Pins"
                config ESP_PANEL_BOARD_EXPANDER_I2C_IO_SCL
                    int "SCL"
                    default 18
                    range 0 48
                    help
                    GPIO number for I2C SCL signal.

                config ESP_PANEL_BOARD_EXPANDER_I2C_IO_SDA
                    int "SDA"
                    default 8
                    range 0 48
                    help
                        GPIO number for I2C SDA signal.

                config ESP_PANEL_BOARD_EXPANDER_I2C_SCL_PULLUP
                    bool "Enable SCL pull-up"
                    default y
                    help
                        Enable internal pull-up for SCL line.

                config ESP_PANEL_BOARD_EXPANDER_I2C_SDA_PULLUP
                    bool "Enable SDA pull-up"
                    default y
                    help
                        Enable internal pull-up for SDA line.
            endmenu
        endif
    endmenu
endif
```

## src/libraries/ESP32_Display_Panel/src/board/custom/Kconfig.board_custom.touch
```kconfig
menuconfig ESP_PANEL_BOARD_USE_TOUCH
    bool "Touch panel settings"
    default n
    help
        Enable this option if you are using a touch panel.

if ESP_PANEL_BOARD_USE_TOUCH
    choice
        prompt "Controller"
        default ESP_PANEL_BOARD_TOUCH_CONTROLLER_TT21100

        config ESP_PANEL_BOARD_TOUCH_CONTROLLER_AXS15231B
            bool "AXS15231B"

        config ESP_PANEL_BOARD_TOUCH_CONTROLLER_CST816S
            bool "CST816S"

        config ESP_PANEL_BOARD_TOUCH_CONTROLLER_FT5x06
            bool "FT5x06"

        config ESP_PANEL_BOARD_TOUCH_CONTROLLER_GT911
            bool "GT911"

        config ESP_PANEL_BOARD_TOUCH_CONTROLLER_GT1151
            bool "GT1151"

        config ESP_PANEL_BOARD_TOUCH_CONTROLLER_SPD2010
            bool "SPD2010"

        config ESP_PANEL_BOARD_TOUCH_CONTROLLER_ST1633
            bool "ST1633"

        config ESP_PANEL_BOARD_TOUCH_CONTROLLER_ST7123
            bool "ST7123"

        config ESP_PANEL_BOARD_TOUCH_CONTROLLER_STMPE610
            bool "STMPE610"

        config ESP_PANEL_BOARD_TOUCH_CONTROLLER_TT21100
            bool "TT21100"

        config ESP_PANEL_BOARD_TOUCH_CONTROLLER_XPT2046
            bool "XPT2046"
    endchoice

    menu "Bus settings"
        choice
            prompt "Bus type"
            default ESP_PANEL_BOARD_TOUCH_BUS_TYPE_I2C

            config ESP_PANEL_BOARD_TOUCH_BUS_TYPE_I2C
                bool "I2C"

            config ESP_PANEL_BOARD_TOUCH_BUS_TYPE_SPI
                bool "SPI"
        endchoice

        config ESP_PANEL_BOARD_TOUCH_BUS_SKIP_INIT_HOST
            bool "Skip bus host initialization"
            depends on ESP_PANEL_BOARD_TOUCH_BUS_TYPE_I2C || ESP_PANEL_BOARD_TOUCH_BUS_TYPE_SPI
            default n
            help
                If enabled, the bus will skip initializing the corresponding host.
                Users need to initialize the host in advance.
                For drivers created by this library, even if they use the same host,
                the host will be initialized only once. So it is not necessary to enable this.
                For other drivers (like Wire), please enable this to ensure the host is
                initialized only once.

        config ESP_PANEL_BOARD_TOUCH_BUS_TYPE
            int
            default 0 if ESP_PANEL_BOARD_TOUCH_BUS_TYPE_SPI
            default 3 if ESP_PANEL_BOARD_TOUCH_BUS_TYPE_I2C

        if ESP_PANEL_BOARD_TOUCH_BUS_TYPE_I2C
            config ESP_PANEL_BOARD_TOUCH_I2C_HOST_ID
                int "I2C host ID"
                default 0
                range 0 1
                help
                    I2C host ID, typically set to 0.

            config ESP_PANEL_BOARD_TOUCH_I2C_ADDRESS
                int "I2C address (7-bit)"
                default 0
                range 0 127
                help
                    For touch controllers with only one address, set to 0.
                    For controllers with multiple addresses, set to 0 or the specific address.
                    For example, GT911 has two addresses: 0x5D(default) and 0x14.

            if !ESP_PANEL_BOARD_TOUCH_BUS_SKIP_INIT_HOST
                config ESP_PANEL_BOARD_TOUCH_I2C_CLK_HZ
                    int "I2C clock frequency (Hz)"
                    default 400000
                    range 1 400000
                    help
                        I2C clock frequency, typically set to 400KHz.

                menu "Pins"
                    config ESP_PANEL_BOARD_TOUCH_I2C_IO_SCL
                        int "SCL"
                        default 18
                        range 0 1000

                    config ESP_PANEL_BOARD_TOUCH_I2C_IO_SDA
                        int "SDA"
                        default 8
                        range 0 1000

                    config ESP_PANEL_BOARD_TOUCH_I2C_SCL_PULLUP
                        bool "Enable SCL pull-up"
                        default y

                    config ESP_PANEL_BOARD_TOUCH_I2C_SDA_PULLUP
                        bool "Enable SDA pull-up"
                        default y
                endmenu
            endif
        endif

        if ESP_PANEL_BOARD_TOUCH_BUS_TYPE_SPI
            config ESP_PANEL_BOARD_TOUCH_SPI_HOST_ID
                int "SPI host ID"
                default 1
                range 1 3
                help
                    SPI host ID, typically set to 1.

            if !ESP_PANEL_BOARD_TOUCH_BUS_SKIP_INIT_HOST
                config ESP_PANEL_BOARD_TOUCH_SPI_CLK_HZ
                    int "SPI clock frequency (Hz)"
                    default 40000000
                    range 1 80000000
                    help
                        SPI clock frequency, should be an integer divisor of 80MHz.
            endif

            menu "Pins"
                config ESP_PANEL_BOARD_TOUCH_SPI_IO_CS
                    int "CS"
                    default 5
                    range -1 1000

                if !ESP_PANEL_BOARD_TOUCH_BUS_SKIP_INIT_HOST
                    config ESP_PANEL_BOARD_TOUCH_SPI_IO_SCK
                        int "SCK"
                        default 7
                        range 0 1000

                    config ESP_PANEL_BOARD_TOUCH_SPI_IO_MOSI
                        int "MOSI"
                        default 6
                        range 0 1000

                    config ESP_PANEL_BOARD_TOUCH_SPI_IO_MISO
                        int "MISO"
                        default 9
                        range 0 1000
                endif
            endmenu
        endif
    endmenu

    menu "Transformation settings"
        config ESP_PANEL_BOARD_TOUCH_SWAP_XY
            bool "Swap X and Y axes"
            default n

        config ESP_PANEL_BOARD_TOUCH_MIRROR_X
            bool "Mirror X axis"
            default n

        config ESP_PANEL_BOARD_TOUCH_MIRROR_Y
            bool "Mirror Y axis"
            default n
    endmenu

    menu "Control pins"
        config ESP_PANEL_BOARD_TOUCH_RST_IO
            int "Reset pin"
            default -1
            range -1 48
            help
                Reset pin number. Set to -1 if not used.

        config ESP_PANEL_BOARD_TOUCH_RST_LEVEL
            depends on ESP_PANEL_BOARD_TOUCH_RST_IO >= 0
            int "Reset active level"
            default 0
            range 0 1
            help
                Reset signal active level. 0: active low, 1: active high.

        config ESP_PANEL_BOARD_TOUCH_INT_IO
            int "Interrupt pin"
            default -1
            range -1 48
            help
                Interrupt pin number. Set to -1 if not used.

        config ESP_PANEL_BOARD_TOUCH_INT_LEVEL
            depends on ESP_PANEL_BOARD_TOUCH_INT_IO >= 0
            int "Interrupt active level"
            default 0
            range 0 1
            help
                Interrupt signal active level. 0: active low, 1: active high.
    endmenu
endif
```

## src/libraries/ESP32_Display_Panel/src/board/supported/elecrow/Kconfig.elecrow
```kconfig
config BOARD_ELECROW_CROWPANEL_7_0
    bool "ELECROW_CROWPANEL_7_0"
    help
        https://www.elecrow.com/esp32-display-7-inch-hmi-display-rgb-tft-lcd-touch-screen-support-lvgl.html
```

## src/libraries/ESP32_Display_Panel/src/board/supported/m5stack/Kconfig.m5stack
```kconfig
config BOARD_M5STACK_M5CORE2
    bool "M5STACK_M5CORE2"
    help
        https://docs.m5stack.com/en/core/core2

config BOARD_M5STACK_M5CORES3
    bool "M5STACK_M5CORES3"
    help
        https://docs.m5stack.com/en/core/CoreS3

config BOARD_M5STACK_M5DIAL
    bool "M5STACK_M5DIAL"
    help
        https://docs.m5stack.com/en/core/M5Dial
```
